## drivers/char/idein/Kconfig
```kconfig
#
# Idein char driver config
#

menuconfig IDEIN_CHAR_DRIVERS
        bool "Idein Char Drivers"
        help
          Idein's char drivers

if IDEIN_CHAR_DRIVERS

config IDEIN_VC4MEM
	bool "Idein memory driver for VideoCore IV"
	default y
	depends on IDEIN_MAILBOX
	help
	  A driver for VideoCore IV memory alloc/free/sync.

config IDEIN_MAILBOX
	bool "Idein mailbox driver for Raspberry Pi"
	default y
	help
	  A driver for Mailbox interface of Raspberry Pi.

endif
```
